## Kconfig
```kconfig
#
# Copyright 2017, Data61
# Commonwealth Scientific and Industrial Research Organisation (CSIRO)
# ABN 41 687 119 230.
#
# This software may be distributed and modified according to the terms of
# the BSD 2-Clause license. Note that NO WARRANTY is provided.
# See "LICENSE_BSD2.txt" for details.
#
# @TAG(DATA61_BSD)
#
mainmenu "Rumprun project configuration"

config COMMON_PATH
    string
    option env="COMMON_PATH"

menu "Kernel"
    source "kernel/Kconfig"
endmenu

menu "Libraries"
    source "libs/libmuslc/Kconfig"
    source "libs/libsel4/Kconfig"
    source "libs/libsel4muslcsys/Kconfig"
    source "libs/libsel4platsupport/Kconfig"
    source "libs/libsel4utils/Kconfig"
    source "libs/libcpio/Kconfig"
    source "libs/libelf/Kconfig"
    source "libs/libsel4vspace/Kconfig"
    source "libs/libsel4vka/Kconfig"
    source "libs/libplatsupport/Kconfig"
    source "libs/libsel4debug/Kconfig"
    source "libs/libsel4sync/Kconfig"
    source "libs/libsel4bench/Kconfig"
    source "libs/libutils/Kconfig"
    source "libs/libsel4simple/Kconfig"
    source "libs/libsel4simple-default/Kconfig"
    source "libs/libethdrivers/Kconfig"
    source "libs/libsel4allocman/Kconfig"
    source "libs/libsel4test/Kconfig"
    source "libs/libsel4serialserver/Kconfig"
    source "rumprun/Kconfig"
endmenu

menu "Applications"
    source "apps/roottask/Kconfig"
    source "apps/nginx/Kconfig"
    source "apps/hello/Kconfig"
    source "apps/netserver/Kconfig"
    source "apps/redis/Kconfig"
    source "apps/python/Kconfig"
    source "apps/lmbench/Kconfig"
    source "apps/iperf3/Kconfig"
    source "apps/rust/Kconfig"
    source "apps/multicore_pthread/Kconfig"
    source "apps/memcached/Kconfig"
    source "apps/leveldb/Kconfig"
    source "apps/erlang/Kconfig"
    source "apps/susan/Kconfig"
    source "apps/cjpeg/Kconfig"
    source "apps/djpeg/Kconfig"
    source "apps/madplay/Kconfig"
endmenu

source "$COMMON_PATH/Kconfig"
```

## roottask/Kconfig
```kconfig
#
# Copyright 2017, Data61
# Commonwealth Scientific and Industrial Research Organisation (CSIRO)
# ABN 41 687 119 230.
#
# This software may be distributed and modified according to the terms of
# the BSD 2-Clause license. Note that NO WARRANTY is provided.
# See "LICENSE_BSD2.txt" for details.
#
# @TAG(DATA61_BSD)
#

menuconfig APP_ROOTTASK
    bool "rumprun roottask app"
    default y
    help
        rr roottask application

    config RUMPRUN_MEMORY_MiB
        int "Number of MiB to give Rumprun instance"
        default 16
    depends on APP_ROOTTASK
    help
        Amount of memory to initialise the Rumprun instance with.

    config RUMPRUN_COMMAND_LINE
    string "App Command line"
    default ""
    depends on APP_ROOTTASK

    config RUMPRUN_ENV_STRING
    string "App environment variables"
    default "RUMPRUN_PLATFORM=seL4"
    depends on APP_ROOTTASK
    help
        Specify environment variables for your application.  Note: You need at least one environment variable
        for the config to parse correctly.

    config RUMPRUN_EXTRA_CONFIG
    string "Extra config"
    default ""
    depends on APP_ROOTTASK
    help
        Extra configuration that will be forwarded to Rumprun.

    config RUMPRUN_COOKFS_DIR
    string "cookfs directory"
    default ""
    depends on APP_ROOTTASK

    config RUMPRUN_PLATFORM
        prompt "Configuration"
        string
        depends on APP_ROOTTASK
        default "x86_64_qemu.h"
        help
            Specify which of the machines (in apps/roottask/include/roottask_platform_config) to use
            You can add additional configurations by adding a new .h file.

    config RUMPRUN_USE_PCI_ETHERNET
        bool "PCI Ethernet"
        depends on APP_ROOTTASK
        default n
        help
            Whether to use PCI ethernet devices

    config RUMPRUN_NETWORK_IFNAME
        prompt "Interface name"
        string
        depends on RUMPRUN_USE_PCI_ETHERNET
        default "wm0"
        help
            Network Interface name su ch as "wm0"

    choice
        prompt "Connection method"
        default RUMPRUN_DHCP
        depends on RUMPRUN_USE_PCI_ETHERNET
        help
            Select how to initialise network interface.
        config RUMPRUN_DHCP
            bool "DHCP"
            help
                Try use DHCP
        config RUMPRUN_STATIC
            bool "Static IP"
            help
                Use a static IP
    endchoice

        config RUMPRUN_NETWORK_STATIC_IP
            prompt "Interface name"
            string
            depends on RUMPRUN_USE_PCI_ETHERNET && RUMPRUN_STATIC
            default "10.0.120.101"
            help
                Static IP Address to use

    config USE_HOG_THREAD
    bool "Use hog thread or not"
    default n
    depends on APP_ROOTTASK
    help
        This enables a thread which tries to hog the CPU.  It spins in a
        loop and never yields.  Its purpose is for schedular related benchmarking.

    config HOG_BANDWIDTH
    range 1 100
    int "Hog Thread bandwidth"
    default 25
    depends on KERNEL_RT && USE_HOG_THREAD && APP_ROOTTASK
    help
        This sets the periodic budget of the hog thread on the mcs version of the kernel.
        The value is a percentage the period that the thread gets as its budget.
        25 means that the thread's budget will be 25% of the period.
```
